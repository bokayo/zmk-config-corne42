## config/boards/shields/corne/Kconfig.defconfig
```kconfig
# Copyright (c) 2022 The ZMK Contributors
# SPDX-License-Identifier: MIT

if SHIELD_CORNE_LEFT

config ZMK_KEYBOARD_NAME
    default "CORNE"
    
config ZMK_SPLIT_ROLE_CENTRAL
    default y

endif

if SHIELD_CORNE_LEFT || SHIELD_CORNE_RIGHT

config ZMK_SPLIT
    default y

endif
```

## config/boards/shields/corne/Kconfig.shield
```kconfig
# Copyright (c) 2022 The ZMK Contributors
# SPDX-License-Identifier: MIT

config SHIELD_CORNE_LEFT
    def_bool $(shields_list_contains,totem_left)

config SHIELD_CORNE_RIGHT
    def_bool $(shields_list_contains,totem_right)
```
